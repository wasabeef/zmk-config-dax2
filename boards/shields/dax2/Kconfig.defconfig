## boards/shields/dax2/Kconfig.defconfig
```kconfig
if SHIELD_DAX2_R

config ZMK_KEYBOARD_NAME
  default "dax2_R"

config ZMK_SPLIT_ROLE_CENTRAL
  default y

endif

if SHIELD_DAX2_L

config ZMK_KEYBOARD_NAME
  default "dax2_L"

endif

if SHIELD_DAX2_R || SHIELD_DAX2_L

config ZMK_SPLIT
  default y

endif
```

## boards/shields/dax2/Kconfig.shield
```kconfig
config SHIELD_DAX2_R
  def_bool $(shields_list_contains,dax2_R)

config SHIELD_DAX2_L
  def_bool $(shields_list_contains,dax2_L)
```
